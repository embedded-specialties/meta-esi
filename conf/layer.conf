## conf/layer.conf
```bitbake
# We have a conf and classes directory, add to BBPATH
BBPATH .= ":${LAYERDIR}"

# We have recipes-* directories, add to BBFILES
BBFILES += "${LAYERDIR}/recipes-*/*/*.bb \
            ${LAYERDIR}/recipes-*/*/*.bbappend"

BBFILE_COLLECTIONS += "meta-esi"
BBFILE_PATTERN_meta-esi = "^${LAYERDIR}/"
BBFILE_PRIORITY_meta-esi = "6"

LAYERDEPENDS_meta-esi = "core"
LAYERSERIES_COMPAT_meta-esi = "dunfell"
```
